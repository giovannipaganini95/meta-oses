## conf/layer.conf
```bitbake
# We have a conf and classes directory, add to BBPATH
BBPATH .= ":${LAYERDIR}"

# We have recipes-* directories, add to BBFILES
BBFILES += "${LAYERDIR}/recipes-*/*/*.bb \
            ${LAYERDIR}/recipes-*/*/*.bbappend"

BBFILE_COLLECTIONS += "meta-oses"
BBFILE_PATTERN_meta-oses = "^${LAYERDIR}/"
BBFILE_PRIORITY_meta-oses = "6"

LAYERDEPENDS_meta-oses = "core"
LAYERSERIES_COMPAT_meta-oses = "dunfell thud warrior zeus"
```
